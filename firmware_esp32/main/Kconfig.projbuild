## firmware_esp32/main/Kconfig.projbuild
```kconfig
menu "Experimento REQ/ACK"
config SE_REQ_GPIO
    int "GPIO de saída REQ"
    range 0 33
    default 25
config SE_ACK_GPIO
    int "GPIO de entrada ACK"
    range 0 39
    default 26
config SE_UART_TX_GPIO
    int "GPIO TX da UART0"
    range 0 33
    default 1
config SE_UART_RX_GPIO
    int "GPIO RX da UART0"
    range 0 39
    default 3
endmenu
```

## firmware_esp32/sdkconfig.defaults
```kconfig
CONFIG_IDF_TARGET="esp32"
CONFIG_ESP_DEFAULT_CPU_FREQ_MHZ_240=y
CONFIG_PM_ENABLE=n
CONFIG_FREERTOS_UNICORE=n
CONFIG_GPTIMER_ISR_CACHE_SAFE=y
CONFIG_GPTIMER_CTRL_FUNC_IN_IRAM=y
CONFIG_GPIO_CTRL_FUNC_IN_IRAM=y
CONFIG_ESP_CONSOLE_NONE=y
CONFIG_LOG_DEFAULT_LEVEL_NONE=y
CONFIG_BOOTLOADER_LOG_LEVEL_NONE=y
CONFIG_COMPILER_OPTIMIZATION_PERF=y
CONFIG_ESP_MAIN_TASK_AFFINITY_CPU0=y
CONFIG_SE_REQ_GPIO=25
CONFIG_SE_ACK_GPIO=26
CONFIG_SE_UART_TX_GPIO=1
CONFIG_SE_UART_RX_GPIO=3
```
